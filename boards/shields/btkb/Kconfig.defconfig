## boards/shields/btkb/Kconfig.defconfig
```kconfig
if SHIELD_BTKB_LEFT

# Name must be less than 16 characters long!
config ZMK_KEYBOARD_NAME
    default "Nickacide kb"

config ZMK_SPLIT_ROLE_CENTRAL
    default y

endif

if SHIELD_BTKB_LEFT || SHIELD_BTKB_RIGHT

config ZMK_SPLIT
    default y

endif
```

## boards/shields/btkb/Kconfig.shield
```kconfig
config SHIELD_BTKB_LEFT
	def_bool $(shields_list_contains,btkb_left)

config SHIELD_BTKB_RIGHT
	def_bool $(shields_list_contains,btkb_right)
```
